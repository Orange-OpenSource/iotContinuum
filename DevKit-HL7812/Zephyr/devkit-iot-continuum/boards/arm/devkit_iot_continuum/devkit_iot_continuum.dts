/*
 * Copyright (c) 2023 Lacroix Impulse
 *
 * SPDX-License-Identifier: Apache-2.0
 */

/dts-v1/;
#include "devkit_iot_continuum-common.dtsi"

/ {
	model = "devkit_iot_continuum board based on stm32u585 MCU";
	compatible = "devkit_iot_continuum";

	chosen {
		zephyr,console = &usart3;
		zephyr,shell-uart = &usart3;
		zephyr,sram = &sram0;
		zephyr,flash = &flash0;
	};
};

