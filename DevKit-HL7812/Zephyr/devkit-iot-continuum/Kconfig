## DevKit-HL7812/Zephyr/devkit-iot-continuum/Kconfig
```kconfig
# Copyright (c) Lacroix Impulse 2023 (France)
# SPDX-License-Identifier: Apache-2.0
#
# This Kconfig file is picked by the Zephyr build system because it is defined
# as the module Kconfig entry point (see zephyr/module.yml). You can browse
# module options by going to Zephyr -> Modules in Kconfig.

mainmenu "devkit_iot_continuum Modules Configuration"

rsource "subsys/Kconfig"
rsource "drivers/Kconfig"
```

## DevKit-HL7812/Zephyr/devkit-iot-continuum/boards/arm/devkit_iot_continuum/devkit_iot_continuum_defconfig
```kconfig
# Copyright (c) Lacroix Impulse 2023 (France)
# SPDX-License-Identifier: Apache-2.0

CONFIG_BOARD_DEVKIT_IOT_CONTINUUM=y
CONFIG_SOC_SERIES_STM32U5X=y
CONFIG_SOC_STM32U585XX=y

# enable uart driver
CONFIG_SERIAL=y

# enable GPIO
CONFIG_GPIO=y

# Enable Clocks
CONFIG_CLOCK_CONTROL=y
# CONFIG_RTC=y
# CONFIG_RTC_STM32=y
CONFIG_ARM_MPU=y

# console
CONFIG_CONSOLE=y
CONFIG_UART_CONSOLE=y

# enable pin controller
CONFIG_PINCTRL=y
```

## DevKit-HL7812/Zephyr/devkit-iot-continuum/drivers/modem/Kconfig
```kconfig
# Copyright (c) Lacroix Impulse 2023 (France)
# SPDX-License-Identifier: Apache-2.0

rsource "hl7812/Kconfig"
```

## DevKit-HL7812/Zephyr/devkit-iot-continuum/subsys/bsp/modem/Kconfig
```kconfig
# Copyright (c) Lacroix Impulse 2023 (France)
# SPDX-License-Identifier: Apache-2.0

module = BSP_MODEM
module-str = bsp_modem
source "subsys/logging/Kconfig.template.log_config"

config BSP_MODEM
   bool "Enable BSP MODEM"
   select BSP
   select UART
   select GPIO
   select NETWORKING
   select MODEM
   select MODEM_HL7812
   select MODEM_SHELL
   select MODEM_SIM_NUMBERS
   default n
```

## DevKit-HL7812/Zephyr/devkit-iot-continuum/subsys/bsp/system/Kconfig
```kconfig
# Copyright (c) Lacroix Impulse 2023 (France)
# SPDX-License-Identifier: Apache-2.0

module = BSP_SYSTEM
module-str = bsp_system
source "subsys/logging/Kconfig.template.log_config"

config $(module)
   bool "Enable BSP SYSTEM"
   select BSP
   select REBOOT
   default n

config $(module)_SHELL
   bool "Enable shell options for bsp_system"
   default n
```

## Zephyr/devkit-iot-continuum/boards/arm/devkit_iot_continuum/Kconfig.board
```kconfig
# Copyright (c) Lacroix Impulse 2023 (France)
# SPDX-License-Identifier: Apache-2.0

config BOARD_DEVKIT_IOT_CONTINUUM
	bool "devkit_iot_continuum board definition"
	depends on SOC_STM32U585XX
```

## Zephyr/devkit-iot-continuum/boards/arm/devkit_iot_continuum/Kconfig.defconfig
```kconfig
# Copyright (c) Lacroix Impulse 2023 (France)
# SPDX-License-Identifier: Apache-2.0

if BOARD_DEVKIT_IOT_CONTINUUM

config BOARD
	default "devkit_iot_continuum"

config SPI_STM32_INTERRUPT
	default y
	depends on SPI

choice STM32_LPTIM_CLOCK
	default STM32_LPTIM_CLOCK_LSE
	depends on STM32_LPTIM_TIMER
endchoice

endif
```

## Zephyr/devkit-iot-continuum/demo_devkit_iot_continuum/Sensors/sample.yaml
```yaml
# Copyright (c) Lacroix Impulse 2023 (France)
# SPDX-License-Identifier: Apache-2.0

# This file is provided so that the application can be compiled using Twister,
# the Zephyr testing tool. In this file, multiple combinations can be specified,
# so that you can easily test all of them locally or in CI.
sample:
  description: demo_devkit
  name: demo_devkit
common:
    tags: demo_devkit
    platform_allow: devkit_iotcontinuum
tests:
  sample.demo_devkit:
    build_only: true
    tags: demo_devkit
```

## Zephyr/devkit-iot-continuum/demo_devkit_iot_continuum/app_main/Kconfig
```kconfig
# Copyright (c) Lacroix Impulse 2023 (France)
# SPDX-License-Identifier: Apache-2.0

# Config options for demo_devkit

# This file is the application Kconfig entry point. All application Kconfig
# options can be defined here or included via other application Kconfig files.
# You can browse these options using the west targets menuconfig (terminal) or
# guiconfig (GUI).

menu "Zephyr"
source "Kconfig.zephyr"
endmenu

module = DEMO_DEVKIT
module-str = demo_devkit
source "subsys/logging/Kconfig.template.log_config"
```

## Zephyr/devkit-iot-continuum/drivers/Kconfig
```kconfig
# Copyright (c) Lacroix Impulse 2023 (France)
# SPDX-License-Identifier: Apache-2.0

menu "DevKit Iot Continuum Drivers"

rsource "modem/Kconfig"

endmenu
```

## Zephyr/devkit-iot-continuum/subsys/Kconfig
```kconfig
# Copyright (c) Lacroix Impulse 2023 (France)
# SPDX-License-Identifier: Apache-2.0

rsource "bsp/Kconfig"
```

## Zephyr/devkit-iot-continuum/subsys/bsp/Kconfig
```kconfig
# Copyright (c) Lacroix Impulse 2023 (France)
# SPDX-License-Identifier: Apache-2.0

module = BSP
module-str = bsp
source "subsys/logging/Kconfig.template.log_config"

config $(module)
   bool "Enable BSP module"
   default n


rsource "inertial/Kconfig"
rsource "modem/Kconfig"
rsource "bme280/Kconfig"
rsource "system/Kconfig"
```

## Zephyr/devkit-iot-continuum/subsys/bsp/bme280/Kconfig
```kconfig
# Copyright (c) Lacroix Impulse 2023 (France)
# SPDX-License-Identifier: Apache-2.0

module = BSP_BME280
module-str = bsp_bme280
source "subsys/logging/Kconfig.template.log_config"

config $(module)
   bool "Enable BSP INERTIAL"
   select BSP
   select I2C
   select GPIO
   select SENSOR
   default n

config $(module)_SHELL
   bool "Enable BSP BME280 SHELL"
   depends on SHELL
   default n
```

## Zephyr/devkit-iot-continuum/subsys/bsp/inertial/Kconfig
```kconfig
# Copyright (c) Lacroix Impulse 2023 (France)
# SPDX-License-Identifier: Apache-2.0

module = BSP_INERTIAL
module-str = bsp_inertial
source "subsys/logging/Kconfig.template.log_config"

config $(module)
   bool "Enable BSP INERTIAL"
   select BSP
   select I2C
   select GPIO
   select SENSOR
   select LSM6DSO_ENABLE_TEMP
   default n

config $(module)_SHELL
   bool "Enable BSP INERTIAL SHELL"
   depends on SHELL
   default n
```
